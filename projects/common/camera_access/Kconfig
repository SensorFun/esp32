## projects/common/camera_access/Kconfig
```kconfig
config CAMERA_REMOTE_ACCESS
    bool "Require a camera password for remote WebRTC viewers"
    default n
```

## projects/common/provisioning/Kconfig
```kconfig
menu "Wi-Fi provisioning"
config PROVISIONING_SECURE
    bool "Use HTTPS for provisioning"
    default n
endmenu
```

## projects/webrtc/main/Kconfig.projbuild
```kconfig
menu "Camera remote signaling"

config CAMERA_JANUS_API_SECRET
    string "Janus API secret"
    default ""
    help
        Match the local signaling server's JANUS_API_SECRET. Keep sdkconfig and
        build outputs private; the secret is embedded in the flashed firmware.

config CAMERA_JANUS_STUN_URL
    string "STUN URL for direct Janus-signaled camera connections"
    default "stun:stun.l.google.com:19302"
    help
        Only stun: or stuns: URLs are supported. Janus routes signaling messages
        only; the browser and camera establish a direct WebRTC connection.

endmenu
```

## projects/webrtc/sdkconfig.defaults
```kconfig
CONFIG_PROVISIONING_SECURE=y
CONFIG_SPIRAM=y
CONFIG_SPIRAM_USE_MALLOC=y
CONFIG_SPIRAM_MALLOC_ALWAYSINTERNAL=4096
CONFIG_MBEDTLS_EXTERNAL_MEM_ALLOC=y
CONFIG_MBEDTLS_SSL_PROTO_DTLS=y
CONFIG_MBEDTLS_SSL_DTLS_SRTP=y
CONFIG_MBEDTLS_X509_CREATE_C=y
CONFIG_MBEDTLS_PEM_WRITE_C=y
CONFIG_MBEDTLS_CHACHA20_C=y
CONFIG_MBEDTLS_CHACHAPOLY_C=y
CONFIG_PARTITION_TABLE_CUSTOM=y
CONFIG_PARTITION_TABLE_CUSTOM_FILENAME="partitions.csv"
CONFIG_ESP_MAIN_TASK_STACK_SIZE=12288
CONFIG_HTTPD_MAX_REQ_HDR_LEN=2048
CONFIG_HTTPD_MAX_URI_LEN=256
CONFIG_FREERTOS_HZ=1000
CONFIG_ESP_DEFAULT_CPU_FREQ_MHZ_240=y
CONFIG_ESPTOOLPY_FLASHSIZE_4MB=y
CONFIG_ESP_WIFI_STATIC_RX_BUFFER_NUM=6
CONFIG_ESP_WIFI_DYNAMIC_RX_BUFFER_NUM=16
CONFIG_CJSON_NESTING_LIMIT=16
```
