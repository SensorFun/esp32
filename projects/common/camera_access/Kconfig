## projects/common/camera_access/Kconfig
```kconfig
config CAMERA_REMOTE_ACCESS
    bool "Require a camera password for remote WebRTC viewers"
    default n

config CAMERA_REMOTE_VIEWER_URL
    string "Remote viewer address (the camera ID is appended)"
    depends on CAMERA_REMOTE_ACCESS
    default "https://esp32.sensorfun.net/projects/webrtc/"
    help
        After Wi-Fi setup, the setup page links to this address followed by
        the camera ID (its Wi-Fi MAC), where the viewer enters the camera
        password to connect from anywhere.
```

## projects/common/provisioning/Kconfig
```kconfig
menu "Wi-Fi provisioning"
config PROVISIONING_SECURE
    bool "USB provisioning commands and device TLS identity"
    default n
    help
        Enables the USB console provisioning commands (used by the browser
        flasher and tools/provision.py) and creates the TLS identity that the
        camera viewer serves over HTTPS. Wi-Fi is provisioned only over USB;
        the board never opens a setup access point.
endmenu
```

## projects/webrtc/main/Kconfig.projbuild
```kconfig
menu "Camera remote signaling"

config CAMERA_SIGNALING_API_SECRET
    string "Signaling server API secret"
    default ""
    help
        Match the local signaling server's SIGNALING_API_SECRET. Keep sdkconfig and
        build outputs private; the secret is embedded in the flashed firmware.

config CAMERA_SIGNALING_STUN_URL
    string "STUN URL for direct signaled camera connections"
    default "stun:stun.l.google.com:19302"
    help
        Only stun: or stuns: URLs are supported. The signaling server routes
        signaling messages only; the browser and camera establish a direct
        WebRTC connection.

config CAMERA_SNTP_SERVER
    string "SNTP server for recording timestamps"
    default "pool.ntp.org"
    help
        Motion recordings are named by UTC time. Until this server answers,
        the camera uses the clock of the first connected viewer.

endmenu
```
